## components/display/Kconfig
```kconfig
menu "Display Config"

config DISPLAY_USE_ILI9341
    bool "Use ILI9341 display"
    default y

config DISPLAY_USE_XPT2046
    bool "Use XPT2046 touch"
    default y

menu "Display Pin Configuration"
# ------- OLD ----------
# CONFIG_PIN_NUM_MISO=19
# CONFIG_PIN_NUM_MOSI=23
# CONFIG_PIN_NUM_CLK=18
# CONFIG_PIN_NUM_CS=5
# CONFIG_PIN_NUM_DC=21
# CONFIG_PIN_NUM_RST=22
# CONFIG_PIN_NUM_BL=4


config PIN_NUM_MISO
    int "SPI MISO GPIO Pin"
    default 19

config PIN_NUM_MOSI
    int "SPI MOSI GPIO Pin"
    default 23

config PIN_NUM_CLK
    int "SPI CLK GPIO Pin"
    default 18

config PIN_NUM_CS
    int "LCD CS GPIO Pin"
    default 5

config PIN_NUM_DC
    int "LCD DC GPIO Pin"
    default 21

config PIN_NUM_RST
    int "LCD Reset GPIO Pin"
    default 22

config PIN_NUM_BL
    int "Backlight GPIO Pin"
    default 4

endmenu

menu "Touch Pin Configuration"

# ------- OLD ----------
# CONFIG_PIN_NUM_TOUCH_CS=15
# CONFIG_PIN_NUM_TOUCH_IRQ=13

config PIN_NUM_TOUCH_CS
    int "Touch CS GPIO Pin"
    default 15

config PIN_NUM_TOUCH_IRQ
    int "Touch IRQ GPIO Pin"
    default 13

endmenu

menu "SPI Host Configuration"

choice DISPLAY_SPI_HOST
    prompt "SPI Host used for LCD + Touch"
    default DISPLAY_SPI2_HOST

config DISPLAY_SPI1_HOST
    bool "SPI1_HOST (SPI1 - reserved for flash/psram, not recommended)"

config DISPLAY_SPI2_HOST
    bool "SPI2_HOST (VSPI - default, recommended)"

config DISPLAY_SPI3_HOST
    bool "SPI3_HOST (HSPI)"

endchoice

endmenu

menu "LVGL Display Settings"

config LVGL_HOR_RES
    int "Horizontal resolution"
    default 240
    range 1 480
    help
      "Set horizontal resolution of the display."

config LVGL_VER_RES
    int "Vertical resolution"
    default 320
    range 1 480
    help
      "Set vertical resolution of the display."

choice
    prompt "LVGL Color depth"
    default LVGL_COLOR_DEPTH_16

config LVGL_COLOR_DEPTH_8
    bool "8-bit color"

config LVGL_COLOR_DEPTH_16
    bool "16-bit color"

config LVGL_COLOR_DEPTH_32
    bool "32-bit color"

endchoice

endmenu

endmenu
```

## components/gpio_d/Kconfig
```kconfig
menu "External GPIO_D Configuration"

choice GPIO32_MODE
    prompt "GPIO32 mode"
    default GPIO32_MODE_ADC

config GPIO32_MODE_ADC
    bool "ADC1 Channel 4 (ADC Mode)"

config GPIO32_MODE_DIGITAL
    bool "Digital IO Mode"

endchoice

choice GPIO35_MODE
    prompt "GPIO35 mode"
    default GPIO35_MODE_ADC

config GPIO35_MODE_ADC
    bool "ADC1 Channel 7 (ADC Mode)"

config GPIO35_MODE_DIGITAL
    bool "Digital IO Mode"

endchoice

endmenu
```

## components/i2c_ext/Kconfig
```kconfig
menu "External I2C Configuration"

config I2C_EXT_PORT_NUM
    int "I2C Port Number"
    default 0
    range 0 1

config I2C_EXT_SDA_PIN
    int "I2C SDA GPIO Pin"
    default 22

config I2C_EXT_SCL_PIN
    int "I2C SCL GPIO Pin"
    default 21

config I2C_EXT_FREQ_HZ
    int "I2C Frequency (Hz)"
    default 400000
    range 100000 1000000

endmenu
```

## components/sdcard/Kconfig
```kconfig
menu "SD Card SPI Pin Configuration"

config SD_CARD_PIN_NUM_MISO
    int "SD Card SPI MISO Pin"
    default 19

config SD_CARD_PIN_NUM_MOSI
    int "SD Card SPI MOSI Pin"
    default 23

config SD_CARD_PIN_NUM_CLK
    int "SD Card SPI Clock Pin"
    default 18

config SD_CARD_PIN_NUM_CS
    int "SD Card SPI Chip Select Pin"
    default 5

endmenu

menu "Mount Configuration"
config SD_CARD_MAX_FILES
    int "Maximum number of files on SD Card"
    default 5

choice SD_CARD_ALLOCATION_UNIT
    prompt "SPI Host used for LCD + Touch"
    default ALLOCATION_UNIT_KB

config SD_CARD_ALLOCATION_UNIT_BYTE
    bool "BYTE"
config SD_CARD_ALLOCATION_UNIT_KB
    bool "KB (default, recommended)"
config SD_CARD_ALLOCATION_UNIT_MB
    bool "MB"

endchoice

config SD_CARD_ALLOCATION_SIZE
    int "Size of the files in allocation units e.g. B, KB, MB"
    default 16
endmenu
```

## components/uart1/Kconfig
```kconfig
menu "UART1 Configuration"

config UART1_TX_PIN
    int "UART1 TX GPIO Pin"
    default 17

config UART1_RX_PIN
    int "UART1 RX GPIO Pin"
    default 16

config UART1_BUF_SIZE
    int "UART1 RX Buffer Size (bytes)"
    default 1024
    range 128 4096

config UART1_BAUD_RATE
    int "UART1 Baud Rate"
    default 115200

config UART1_DATA_BITS
    int "UART1 Data Bits"
    default 8
    range 5 8

choice
    prompt "UART1 Parity"
    default UART1_PARITY_DISABLE

config UART1_PARITY_DISABLE
    bool "Disable Parity"

config UART1_PARITY_EVEN
    bool "Even Parity"

config UART1_PARITY_ODD
    bool "Odd Parity"

endchoice

config UART1_STOP_BITS
    int "UART1 Stop Bits"
    default 1
    range 1 2

choice
    prompt "UART1 Flow Control"
    default UART1_FLOWCTRL_DISABLE

config UART1_FLOWCTRL_DISABLE
    bool "Disable Flow Control"

config UART1_FLOWCTRL_RTS
    bool "Enable RTS Flow Control"

config UART1_FLOWCTRL_CTS
    bool "Enable CTS Flow Control"

config UART1_FLOWCTRL_RTS_CTS
    bool "Enable RTS/CTS Flow Control"

endchoice

endmenu
```

## main/Kconfig
```kconfig
menu "Main Application Config"

config APP_EXAMPLE
    bool "Enable example LVGL screen"
    default y

source "../components/display/Kconfig"
source "../components/gpio_d/Kconfig"
source "../components/i2c_ext/Kconfig"
source "../components/uart1/Kconfig"
source "../components/sdcard/Kconfig"
source "../components/file_browser/Kconfig"

endmenu
```

## sdkconfig.defaults
```kconfig
#
# Display settings
#
CONFIG_DISPLAY_USE_ILI9341=y
CONFIG_DISPLAY_USE_XPT2046=y

CONFIG_PIN_NUM_MISO=12
CONFIG_PIN_NUM_MOSI=13
CONFIG_PIN_NUM_CLK=14
CONFIG_PIN_NUM_CS=15
CONFIG_PIN_NUM_DC=2
CONFIG_PIN_NUM_RST=-1
CONFIG_PIN_NUM_BL=27

CONFIG_PIN_NUM_TOUCH_CS=33
CONFIG_PIN_NUM_TOUCH_IRQ=36

CONFIG_DISPLAY_SPI2_HOST=y

CONFIG_LVGL_HOR_RES=240
CONFIG_LVGL_VER_RES=320
CONFIG_LVGL_COLOR_DEPTH_16=y

#
# UART1 settings
#
CONFIG_UART1_TX_PIN=17
CONFIG_UART1_RX_PIN=16
CONFIG_UART1_BUF_SIZE=1024
CONFIG_UART1_BAUD_RATE=115200
CONFIG_UART1_DATA_BITS=8
CONFIG_UART1_PARITY_DISABLE=y
CONFIG_UART1_STOP_BITS=1
CONFIG_UART1_FLOWCTRL_DISABLE=y

#
# External I2C settings
#
CONFIG_I2C_EXT_PORT_NUM=0
CONFIG_I2C_EXT_SDA_PIN=22
CONFIG_I2C_EXT_SCL_PIN=21
CONFIG_I2C_EXT_FREQ_HZ=400000

#
# External GPIO_D settings
#
CONFIG_GPIO32_MODE_ADC=y
CONFIG_GPIO35_MODE_ADC=y
```
